## boards/arm64/xenvm/xenvm_defconfig
```kconfig
CONFIG_SOC_XENVM=y
CONFIG_BOARD_XENVM=y
CONFIG_XEN_INITIAL_DOMAIN=y

CONFIG_MAX_XLAT_TABLES=10
CONFIG_HEAP_MEM_POOL_SIZE=16777216
CONFIG_KERNEL_VM_SIZE=0x4000000

# Enable console
CONFIG_CONSOLE=y
CONFIG_UART_CONSOLE=y

# Enable logging subsys
CONFIG_LOG=y
CONFIG_LOG_MODE_MINIMAL=n
CONFIG_LOG_BACKEND_UART=y

CONFIG_USERSPACE=n

CONFIG_SHELL=y

CONFIG_CLOCK_CONTROL=y
CONFIG_GPIO=y
```
